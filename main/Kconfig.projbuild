## main/Kconfig.projbuild
```kconfig
menu "WasmHome common platform"
config WASMHOME_WIFI_SSID
    string "Wi-Fi SSID"
    default "Hal9000"
config WASMHOME_WIFI_PASSWORD
    string "Wi-Fi password (local sdkconfig only)"
    default ""
config WASMHOME_OBSERVER_IPV4
    string "Observer IPv4 address (empty disables UDP)"
    default ""
config WASMHOME_UDP_PORT
    int "UDP observation port (device and observer)"
    range 1024 65535
    default 3333
config WASMHOME_SENSOR_GPIO
    int
    default 4
config WASMHOME_CONTROL_GPIO
    int
    default 5
config WASMHOME_LOOPBACK_GPIO
    int
    default 6
config WASMHOME_PLATFORM_SELFTEST
    bool "Run platform hardware diagnostics (not a functional service)"
    default n
    help
        Publishes diagnostic sensor telemetry and alternates the loopback output.
        Use only on the documented bench; it is not campaign service evidence.
config WASMHOME_LXC_PROBE_IPV4
    string "Temporary LXC transport fixture IPv4 (local sdkconfig only)"
    default ""
    depends on WASMHOME_PLATFORM_SELFTEST
    help
        WH_LXC tests only this IPv4, TCP port 18080 and the fixed diagnostic path.
        Empty disables the probe. The fixture proves HTTP transport only.
config WASMHOME_OBSERVER_SELFTEST
    bool "Run external observer calibration fixture (no OTA or modules)"
    default n
    depends on !WASMHOME_PLATFORM_SELFTEST
    help
        Native-only bench fixture. Replies to control probes using real GPIO
        loopback and publishes sensor telemetry. WH_GAP pauses both channels
        for one second; WH_REBOOT resets the board. Updates are rejected.
        WH_V1 and WH_V2 select the fixture rule without an artifact update.
        This firmware is only for calibrating the external observer.
config WASMHOME_RUN_BENCHMARK
    bool "Run preliminary benchmark after platform startup"
    default n
    depends on !WASMHOME_PLATFORM_SELFTEST && !WASMHOME_OBSERVER_SELFTEST
    help
        Benchmark CSV is diagnostic and does not establish service availability.
config WASMHOME_NATIVE_SERVICES
    bool "Run native DS18B20 telemetry and GPIO control services"
    default n
    depends on !WASMHOME_PLATFORM_SELFTEST && !WASMHOME_OBSERVER_SELFTEST && !WASMHOME_RUN_BENCHMARK
    help
        Installs the real native telemetry and versioned hysteresis control
        services over UDP v1. This option is native-scenario only and is
        mutually exclusive with diagnostics and benchmark firmware.

config WASMHOME_SIGNED_UPDATE
    bool "Enable signed HTTPS artifact updates"
    default n
    depends on WASMHOME_NATIVE_SERVICES || WASMHOME_MODULE_SERVICES
    select MBEDTLS_HAVE_TIME_DATE
    select APP_PROJECT_VER_FROM_CONFIG
    help
        Enables the shared fixed-path HTTPS/COSE downloader and persistent
        anti-rollback state. Trust files are public inputs embedded at build
        time; do not put private signing or TLS keys in this firmware.

config WASMHOME_NATIVE_OTA
    bool "Allow signed native application OTA"
    default n
    depends on WASMHOME_SIGNED_UPDATE && WASMHOME_NATIVE_SERVICES
    select BOOTLOADER_APP_ROLLBACK_ENABLE
    help
        Enables the native UPDATE_TRIGGER path to stage an authenticated ESP-IDF
        application in the inactive OTA slot and request a reboot.

config WASMHOME_RESILIENCE_TEST_MODE
    bool "Enable serial native resilience fixtures"
    default n
    depends on WASMHOME_NATIVE_OTA && WASMHOME_NATIVE_SERVICES && ESP_SYSTEM_PANIC_PRINT_REBOOT
    help
        Opt-in bench-only serial fixtures for native OTA rejection and abort.
        Accepts only a closed JSON request containing event, attempt_id and
        case_id. Envelope fixtures use only the isolated fixture endpoint below.
        The selected panic handler must print diagnostics and reboot. This does
        not enable the normal campaign firmware.

config WASMHOME_RESILIENCE_FIXTURE_SERVER_IPV4
    string "Isolated resilience fixture HTTPS server IPv4"
    default ""
    depends on WASMHOME_RESILIENCE_TEST_MODE || WASMHOME_MODULE_RESILIENCE_TEST_MODE
    help
        Required to enable ENV-SIG/HASH/OLD. Keep these files on an isolated
        endpoint; the campaign artifact servers are not modified or reused.

config WASMHOME_RESILIENCE_FIXTURE_SERVER_PORT
    int "Isolated resilience fixture HTTPS server port"
    range 1 65535
    default 8445
    depends on WASMHOME_RESILIENCE_TEST_MODE || WASMHOME_MODULE_RESILIENCE_TEST_MODE

config WASMHOME_RESILIENCE_FIXTURE_SERVER_NAME
    string "Isolated resilience fixture HTTPS certificate DNS name"
    default ""
    depends on WASMHOME_RESILIENCE_TEST_MODE || WASMHOME_MODULE_RESILIENCE_TEST_MODE

config WASMHOME_RESILIENCE_FUNCTIONAL_TIMEOUT_MS
    int "Candidate functional timeout used by resilience fixture"
    range 100 1000
    default 300
    depends on WASMHOME_RESILIENCE_TEST_MODE
    help
        Initial candidate only. Freeze or adjust after the #20 pilot before
        using it as an acceptance threshold for a campaign.

config WASMHOME_UPDATE_CA_CERT_PATH
    string "Local path to the trusted HTTPS CA certificate (PEM)"
    default ""
    depends on WASMHOME_SIGNED_UPDATE

config WASMHOME_UPDATE_SIGNING_PUBLIC_KEY_PATH
    string "Local path to the pinned COSE signing public key (DER)"
    default ""
    depends on WASMHOME_SIGNED_UPDATE

config WASMHOME_UPDATE_SERVER_IPV4
    string "Fixed HTTPS artifact server IPv4"
    default "192.168.0.138"
    depends on WASMHOME_SIGNED_UPDATE

config WASMHOME_UPDATE_SERVER_NAME
    string "Expected HTTPS certificate DNS name"
    default "wasmhome-bench.test"
    depends on WASMHOME_SIGNED_UPDATE

config WASMHOME_UPDATE_SERVER_PORT
    int "HTTPS artifact server port"
    range 1 65535
    default 8444
    depends on WASMHOME_SIGNED_UPDATE

config WASMHOME_UPDATE_CAMPAIGN_ID
    string "Compiled signed artifact campaign ID"
    default "issues16-18-bench-20261015"
    depends on WASMHOME_SIGNED_UPDATE

config WASMHOME_UPDATE_AOT_TOOLCHAIN_ID
    string "Compiled expected AOT toolchain identity"
    default "wamr-2.4.5-wasmhome.3"
    depends on WASMHOME_SIGNED_UPDATE

config WASMHOME_UPDATE_TIME_SERVER
    string "SNTP server used to validate TLS certificate dates"
    default "pool.ntp.org"
    depends on WASMHOME_SIGNED_UPDATE

config WASMHOME_UPDATE_RELEASE_VERSION
    string "Release label required by the signed update manifest"
    default "v1"
    depends on WASMHOME_SIGNED_UPDATE
    help
        Must match APP_PROJECT_VER, which is embedded into esp_app_desc. Set both
        values to v1 for the bootstrap build and v2 for the OTA candidate.

config WASMHOME_CONTROL_VERSION
    int "Native control policy version fixed in this build"
    range 1 2
    default 1
    depends on WASMHOME_NATIVE_SERVICES
    help
        Version 1 uses the 25 C threshold; version 2 uses the 30 C threshold.
        The selected value is compiled into firmware and cannot be changed at
        runtime.

config WASMHOME_MODULE_SERVICES
    bool "Run the ABI v1 Wasm telemetry and control modules"
    default n
    depends on !WASMHOME_NATIVE_SERVICES && !WASMHOME_PLATFORM_SELFTEST && !WASMHOME_OBSERVER_SELFTEST && !WASMHOME_RUN_BENCHMARK
    help
        Starts the persistent WAMR manager in interpreter/AOT firmware. Two
        role-specific module images must be embedded by the service artifact
        build. Defaults below are provisional and require board acceptance.

config WASMHOME_MODULE_RESILIENCE_TEST_MODE
    bool "Enable serial Wasm trap resilience fixtures"
    default n
    depends on WASMHOME_MODULE_SERVICES && WASMHOME_SIGNED_UPDATE
    help
        Opt-in bench-only requests for compile-time embedded Wasm traps and
        fixed-path signed-envelope fixtures. The serial request selects only
        a closed case ID and attempt ID; it cannot supply artifact bytes, a
        path or a URL. Trap fixtures use the inactive control slot. Envelope
        fixtures use the isolated HTTPS endpoint and real module-slot/NVS
        validator path. Signed updates and the endpoint pins are required.

config WASMHOME_MODULE_RESILIENCE_FUNCTIONAL_TIMEOUT_MS
    int "Candidate functional timeout used by module resilience fixture"
    range 100 1000
    default 300
    depends on WASMHOME_MODULE_RESILIENCE_TEST_MODE
    help
        Initial candidate only. Freeze or adjust after the #20 pilot before
        using it as an acceptance threshold for a campaign.

config WASMHOME_MODULE_CONTROL_VERSION
    int "Host-assigned control module version"
    range 1 2
    default 1
    depends on WASMHOME_MODULE_SERVICES
    help
        Selects the embedded control v1/v2 image. This host metadata is written
        into CONTROL_RESULT and is not read from the guest.

config WASMHOME_MODULE_MAX_ARTIFACT_BYTES
    int "Maximum bytes per embedded module artifact (provisional)"
    range 1024 1048576
    default 65536
    depends on WASMHOME_MODULE_SERVICES

config WASMHOME_MODULE_MAX_MEMORY_PAGES
    int "Maximum linear-memory pages per module (provisional)"
    range 1 64
    default 2
    depends on WASMHOME_MODULE_SERVICES

config WASMHOME_MODULE_WASM_STACK_BYTES
    int "Wasm execution stack bytes per module (provisional)"
    range 4096 32768
    default 8192
    depends on WASMHOME_MODULE_SERVICES

config WASMHOME_MODULE_APP_HEAP_BYTES
    int "Host-managed app heap bytes per module (provisional)"
    range 4096 65536
    default 8192
    depends on WASMHOME_MODULE_SERVICES

config WASMHOME_MODULE_ALLOCATOR_CAP_BYTES
    int "Global WAMR plus artifact live-byte cap (provisional)"
    range 32768 2097152
    default 524288
    depends on WASMHOME_MODULE_SERVICES

config WASMHOME_MODULE_HOST_THREAD_STACK_BYTES
    int "Manager pthread stack bytes (provisional)"
    range 8192 32768
    default 12288
    depends on WASMHOME_MODULE_SERVICES
endmenu
```

## sdkconfig.defaults
```kconfig
CONFIG_ESP_DEFAULT_CPU_FREQ_MHZ_240=y
CONFIG_ESP_DEFAULT_CPU_FREQ_MHZ=240
CONFIG_FREERTOS_HZ=1000
CONFIG_COMPILER_OPTIMIZATION_PERF=y
CONFIG_ESP_TASK_WDT_EN=y
CONFIG_ESP_TASK_WDT_INIT=y
CONFIG_ESP_TASK_WDT_TIMEOUT_S=5
CONFIG_ESP_TASK_WDT_PANIC=y
CONFIG_ESP_TASK_WDT_CHECK_IDLE_TASK_CPU0=y
CONFIG_ESP_TASK_WDT_CHECK_IDLE_TASK_CPU1=y
CONFIG_ESPTOOLPY_FLASHSIZE_16MB=y
CONFIG_PARTITION_TABLE_CUSTOM=y
CONFIG_PARTITION_TABLE_CUSTOM_FILENAME="partitions.csv"
CONFIG_SPIRAM=y
CONFIG_SPIRAM_MODE_OCT=y
CONFIG_SPIRAM_SPEED_80M=y
CONFIG_SPIRAM_USE_MALLOC=y
CONFIG_SPIRAM_MALLOC_ALWAYSINTERNAL=16384
CONFIG_SPIRAM_MALLOC_RESERVE_INTERNAL=32768
CONFIG_ESP_WIFI_STATIC_RX_BUFFER_NUM=10
CONFIG_ESP_WIFI_DYNAMIC_RX_BUFFER_NUM=32
CONFIG_ESP_WIFI_DYNAMIC_TX_BUFFER_NUM=32
CONFIG_ESP_WIFI_DYNAMIC_TX_BUFFER=y
# App-slot bench trials must not persist RF calibration outside the app slot.
CONFIG_ESP_PHY_CALIBRATION_AND_DATA_STORAGE=n
# CONFIG_SPIRAM_TRY_ALLOCATE_WIFI_LWIP is not set
# CONFIG_PM_ENABLE is not set
```
